#include "zmk-helpers/key-labels/sofle.h"

#include <behaviors.dtsi>
#include <behaviors/num_word.dtsi> // Requires zmk-auto-layer module.
#include <behaviors/unicode.dtsi> // Requires zmk-unicode module.
#include <zmk-helpers/helper.h> // Requires zmk-helpers module.
#include <dt-bindings/zmk/keys.h>
#include <dt-bindings/zmk/bt.h>
#include <dt-bindings/zmk/outputs.h>
#define _BT_SEL_KEYS_                                                        \
    &bt BT_SEL 0 &bt BT_SEL 1 &bt BT_SEL 2 &bt BT_SEL 3 &bt BT_CLR

#define DEF 0
#define NAV 1
#define SYM 2
#define NUM 3
#define FN 4
#define MOUSE 5

#define XXX &none
#define ___ &trans

/* Global defaults */

#define QUICK_TAP_MS 175

&sk {
  release-after-ms = <900>;
  quick-release;
};

&sl { // Allow sticky mods to chord across sticky layers.
  ignore-modifiers;
};

&lt {
  flavor = "balanced";
  tapping-term-ms = <200>;
  quick-tap-ms = <QUICK_TAP_MS>;
};

/*  Homerow mods
    60 KEY MATRIX / LAYOUT MAPPING

╭─────────────────────────────┬─────────────────────────────╮
│ LN5 LN4 LN3 LN2 LN1 LN0     │     RN0 RN1 RN2 RN3 RN4 RN5 │
│ LT5 LT4 LT3 LT2 LT1 LT0     │     RT0 RT1 RT2 RT3 RT4 RT5 │
│ LM5 LM4 LM3 LM2 LM1 LM0     │     RM0 RM1 RM2 RM3 RM4 RM5 │
│ LB5 LB4 LB3 LB2 LB1 LB0 LEC │ REC RB0 RB1 RB2 RB3 RB4 RB5 │
╰───────╮ LH4 LH3 LH2 LH1 LH0 │ RH0 RH1 RH2 RH3 RH4 ╭───────╯
        ╰─────────────────────┴─────────────────────╯         */

#define KEYS_L LN0 LN1 LN2 LN3 LN4 LN5  \
    LT0 LT1 LT2 LT3 LT4 LT5             \
    LM0 LM1 LM2 LM3 LM4 LM5             \
    LEC LB0 LB1 LB2 LB3 LB4 LB5
#define KEYS_R RN0 RN1 RN2 RN3 RN4 RN5  \
    RT0 RT1 RT2 RT3 RT4 RT5             \
    RM0 RM1 RM2 RM3 RM4 RM5             \
    REC RB0 RB1 RB2 RB3 RB4 RB5
#define THUMBS LH4 LH3 LH2 LH1 LH0 \
    RH0 RH1 RH2 RH3 RH4

#define MAKE_HRM(NAME, HOLD, TAP, TRIGGER_POS)                                 \
  ZMK_HOLD_TAP(NAME, bindings = <HOLD>, <TAP>; flavor = "balanced";            \
               tapping-term-ms = <280>; quick-tap-ms = <QUICK_TAP_MS>;         \
               require-prior-idle-ms = <150>; hold-trigger-on-release;         \
               hold-trigger-key-positions = <TRIGGER_POS>;)

MAKE_HRM(hml, &kp, &kp, KEYS_R THUMBS) // Left-hand HRMs.
MAKE_HRM(hmr, &kp, &kp, KEYS_L THUMBS) // Right-hand HRMs.

// Hack: Make HRM combos tap-only (cf, ZMK issue #544).
#define ZMK_COMBO_8(NAME, TAP, POS, LAYERS, COMBO_MS, IDLE_MS, HOLD, SIDE)     \
  MAKE_HRM(hm_combo_##NAME, &kp, TAP, SIDE THUMBS)                             \
  ZMK_COMBO_6(NAME, &hm_combo_##NAME HOLD 0, POS, LAYERS, COMBO_MS, IDLE_MS)

/* Base local mapping */

#ifdef LANG_DE
    #include "keys_de.h"
#else
    #include "keys_en.h"
#endif

/* Combos, leader key sequences, mouse emulation */

#include "combos.dtsi" // Must be sourced after HRM-combo hack.
#include "leader.dtsi"
#include "mouse.dtsi"

/* Navigation layer (vim-style HJKL on right homerow)
   - HJKL: arrows (use left hmr for Shift+select, left hml for Ctrl+word-jump)
   - PGUP/DN on RT2/RB2 (above/below arrow cluster)
   - HOME/END/DEL on bottom row
   - BSPC on middle thumb (RH2)
*/

/* Magic-shift & auto-layers */

// Tap: repeat after alpha, else sticky-shift |
// Shift + tap/ double-tap: caps-word | Hold: shift.
#define MAGIC_SHIFT &magic_shift LSHFT 0
ZMK_HOLD_TAP(magic_shift, bindings = <&kp>, <&magic_shift_tap>;
             flavor = "balanced"; tapping-term-ms = <200>;
             quick-tap-ms = <QUICK_TAP_MS>;)
ZMK_MOD_MORPH(magic_shift_tap, bindings = <&shift_repeat>, <&caps_word>;
              mods = <(MOD_LSFT)>;)
ZMK_ADAPTIVE_KEY(
    shift_repeat, bindings = <&sk LSHFT>;
    repeat {
      trigger-keys = <KEY_A KEY_B KEY_C KEY_D KEY_E KEY_F KEY_G KEY_H KEY_I KEY_J KEY_K KEY_L KEY_M KEY_N KEY_O KEY_P KEY_Q KEY_R KEY_S KEY_T KEY_U KEY_V KEY_W KEY_X KEY_Y KEY_Z KEY_OE KEY_UE KEY_AE KEY_SZ>;
      bindings = <&key_repeat>;
      max-prior-idle-ms = <1200>;
      strict-modifiers;
    };)
&caps_word { // Mods deactivate caps-word, requires PR #1451. [TODO: rebase]
  /delete-property/ ignore-modifiers;
};

// Tap: num-word | double-tap: sticky num-layer | Hold: num-layer.
#define SMART_NUM &smart_num NUM 0
ZMK_HOLD_TAP(smart_num, bindings = <&mo>, <&num_dance>; flavor = "balanced";
             tapping-term-ms = <200>; quick-tap-ms = <QUICK_TAP_MS>;)
ZMK_TAP_DANCE(num_dance, bindings = <&num_word NUM>, <&sl NUM>;
              tapping-term-ms = <200>;)

// Smart-mouse, requires tri-state module.
ZMK_TRI_STATE(
    smart_mouse, bindings = <&tog MOUSE>, <&none>, <&tog MOUSE>;
    ignored-key-positions =
        <LT1 LT2 LH0 LH1 RT1 RT2 RT3 RM0 RM1 RM2 RM3 RM4 RB1 RB2 RB3 RH0 RH1>;
    ignored-layers = <MOUSE NAV SYM>;)

/* Custom behaviors */

// Define mod-morph with a *single* mod trigger for less repetition.
#define SIMPLE_MORPH(NAME, MOD, BINDING1, BINDING2)                            \
  ZMK_MOD_MORPH(NAME, mods = <(MOD_L##MOD | MOD_R##MOD)>;                      \
                bindings = <BINDING1>, <BINDING2>;)

// Tap: comma | Shift + tap: semicolon | Ctrl + shift + tap: <.
SIMPLE_MORPH(comma_morph, SFT, &kp KEY_COMMA, &comma_inner_morph)
SIMPLE_MORPH(comma_inner_morph, CTL, &kp KEY_SEMICOLON, &kp KEY_LT)

// Tap: dot | Shift + tap: colon | Ctrl + shift + tap: >.
SIMPLE_MORPH(dot_morph, SFT, &kp KEY_DOT, &dot_inner_morph)
SIMPLE_MORPH(dot_inner_morph, CTL, &kp KEY_COLON, &kp KEY_GT)

// Tap: ? | Shift + tap: !.
SIMPLE_MORPH(qexcl, SFT, &kp KEY_QUESTION, &kp KEY_EXCLAMATION)

// Tap: left/right parenthesis | Shft + tap: less-than/greater-than.
SIMPLE_MORPH(lpar_lt, SFT, &kp KEY_LEFT_PAREN, &kp KEY_LT)
SIMPLE_MORPH(rpar_gt, SFT, &kp KEY_RIGHT_PAREN, &kp KEY_GT)

// Tap: space | Shift + tap: dot -> space -> sticky shift | Hold: nav layer.
ZMK_HOLD_TAP(lt_spc, bindings = <&mo>, <&spc_morph>; flavor = "balanced";
             tapping-term-ms = <200>; quick-tap-ms = <QUICK_TAP_MS>;)
SIMPLE_MORPH(spc_morph, SFT, &kp SPACE, &dot_spc)
ZMK_MACRO(dot_spc, bindings = <&kp KEY_DOT &kp SPACE &sk LSHFT>; wait-ms = <0>;
          tap-ms = <5>;)

// Tap: backspace | Lshft + tap: delete | Rshft + tap: shift-delete.
ZMK_MOD_MORPH(bs_del, bindings = <&kp BSPC>, <&kp DEL>;
              mods = <(MOD_LSFT|MOD_RSFT)>; keep-mods = <MOD_RSFT>;)

&num_word {
    continue-list = <N0 N1 N2 N3 N4 N5 N6 N7 N8 N9 KEY_DOT KEY_COMMA KEY_PLUS KEY_MINUS KEY_STAR KEY_SLASH KEY_EQUAL BSPC DEL SPACE>;
};

// Sticky shift + leader.
ZMK_MACRO(leader_sft, bindings = <&sk LSHFT &leader>;)

// Misc aliases. [TODO: clean up]
#define CANCEL    &kp K_CANCEL            // Cancel caps-word & auto-layers.

/* Keymap */

#define ZMK_BASE_LAYER(name, LN, RN, LT, RT, LM, RM, LB, LE, RE, RB, LH, RH)                 \
    ZMK_LAYER(name, LN RN LT RT LM RM LB LE RE RB LH RH)

ZMK_BASE_LAYER(Base,
//╭─────────────────┬─────────────────┬─────────────────┬─────────────────┬─────────────────┬─────────────────╮                                       ╭─────────────────┬─────────────────┬─────────────────┬─────────────────┬─────────────────┬─────────────────╮
   &kp ESC           &kp N1            &kp N2            &kp N3            &kp N4            &kp N5           ,                                        &kp N6            &kp N7            &kp N8            &kp N9            &kp N0            &kp KEY_SZ       ,
//├─────────────────┼─────────────────┼─────────────────┼─────────────────┼─────────────────┼─────────────────┤                                       ├─────────────────┼─────────────────┼─────────────────┼─────────────────┼─────────────────┼─────────────────┤
   &qexcl            &kp KEY_Q         &kp KEY_W         &kp KEY_E         &kp KEY_R         &kp KEY_T        ,                                        &kp KEY_Y         &kp KEY_U         &kp KEY_I         &kp KEY_O         &kp KEY_P         &kp KEY_UE       ,
//├─────────────────┼─────────────────┼─────────────────┼─────────────────┼─────────────────┼─────────────────┤                                       ├─────────────────┼─────────────────┼─────────────────┼─────────────────┼─────────────────┼─────────────────┤
   XXX               &hml LGUI KEY_A   &hml LALT KEY_S   &hml LSHFT KEY_D  &hml LCTRL KEY_F  &kp KEY_G        ,                                        &kp KEY_H         &hmr LCTRL KEY_J  &hmr RSHFT KEY_K  &hmr LALT KEY_L   &hmr LGUI KEY_OE  &kp KEY_AE       ,
//├─────────────────┼─────────────────┼─────────────────┼─────────────────┼─────────────────┼─────────────────┤─────────────────╮   ╭─────────────────├─────────────────┼─────────────────┼─────────────────┼─────────────────┼─────────────────┼─────────────────┤
   XXX               &kp KEY_Z         &kp KEY_X         &kp KEY_C         &kp KEY_V         &kp KEY_B        ,XXX              ,    XXX              ,&kp KEY_N         &kp KEY_M         &comma_morph      &dot_morph        &kp KEY_MINUS     XXX              ,
//╰─────────────────┴─────────────────┼─────────────────┼─────────────────┼─────────────────┼─────────────────┼─────────────────┤   ├─────────────────┼─────────────────┼─────────────────┼─────────────────┼─────────────────┼─────────────────┴─────────────────╯
                                        XXX               &lt SYM TAB       &lt_spc NUM 0     &lt NAV RET       &kp ESC          ,    &lt NAV ESC       &lt_spc FN 0      &bs_del           MAGIC_SHIFT       XXX
//                                    ╰─────────────────┴─────────────────┴─────────────────┴─────────────────┴─────────────────╯   ╰─────────────────┴─────────────────┴─────────────────┴─────────────────┴─────────────────╯
)

ZMK_BASE_LAYER(NAV,
//╭─────────────────┬─────────────────┬─────────────────┬─────────────────┬─────────────────┬─────────────────╮                                       ╭─────────────────┬─────────────────┬─────────────────┬─────────────────┬─────────────────┬─────────────────╮
   ___               ___               ___               ___               ___               ___              ,                                        ___               ___               ___               ___               ___               XXX              ,
//├─────────────────┼─────────────────┼─────────────────┼─────────────────┼─────────────────┼─────────────────┤                                       ├─────────────────┼─────────────────┼─────────────────┼─────────────────┼─────────────────┼─────────────────┤
   ___               &kp LC(KEY_Z)     &kp LC(LS(KEY_Z)) &kp LC(KEY_A)     XXX               XXX              ,                                        &kp DEL           XXX               &kp PAGE_UP       XXX               XXX               XXX              ,
//├─────────────────┼─────────────────┼─────────────────┼─────────────────┼─────────────────┼─────────────────┤                                       ├─────────────────┼─────────────────┼─────────────────┼─────────────────┼─────────────────┼─────────────────┤
   ___               ___               ___               ___               ___               ___              ,                                        &kp LEFT          &kp DOWN          &kp UP            &kp RIGHT         XXX               XXX              ,
//├─────────────────┼─────────────────┼─────────────────┼─────────────────┼─────────────────┼─────────────────┤─────────────────╮   ╭─────────────────├─────────────────┼─────────────────┼─────────────────┼─────────────────┼─────────────────┼─────────────────┤
   ___               &kp LC(BSPC)      &kp LC(DEL)       XXX               XXX               XXX              ,___              ,    ___              ,&kp HOME          &kp PAGE_DOWN     XXX               &kp END           ___               ___              ,
//╰─────────────────┴─────────────────┼─────────────────┼─────────────────┼─────────────────┼─────────────────┼─────────────────┤   ├─────────────────┼─────────────────┼─────────────────┼─────────────────┼─────────────────┼─────────────────┴─────────────────╯
                                       ___               ___               ___               ___               ___              ,    ___               ___               ___               ___               ___
//                                    ╰─────────────────┴─────────────────┴─────────────────┴─────────────────┴─────────────────╯   ╰─────────────────┴─────────────────┴─────────────────┴─────────────────┴─────────────────╯
)

ZMK_BASE_LAYER(Sym,
//╭─────────────────┬─────────────────┬─────────────────┬─────────────────┬─────────────────┬─────────────────╮                                       ╭─────────────────┬─────────────────┬─────────────────┬─────────────────┬─────────────────┬─────────────────╮
   ___               XXX               XXX               XXX               XXX               XXX              ,                                        XXX               XXX               XXX               XXX               XXX               XXX              ,
//├─────────────────┼─────────────────┼─────────────────┼─────────────────┼─────────────────┼─────────────────┤                                       ├─────────────────┼─────────────────┼─────────────────┼─────────────────┼─────────────────┼─────────────────┤
   &kp KEY_PERCENT   &kp KEY_AT        &kp KEY_AMPERSAND &kp KEY_PLUS      &kp KEY_MINUS     &kp KEY_DOLLAR   ,                                        &kp KEY_HASH      &kp KEY_STAR      &kp KEY_SLASH     &kp KEY_PIPE      &kp KEY_CARET     XXX              ,
//├─────────────────┼─────────────────┼─────────────────┼─────────────────┼─────────────────┼─────────────────┤                                       ├─────────────────┼─────────────────┼─────────────────┼─────────────────┼─────────────────┼─────────────────┤
   XXX               &hml LGUI KEY_LT  &hml LALT KEY_LEFT_PAREN &hml LSHFT KEY_LEFT_BRACKET &hml LCTRL KEY_LEFT_BRACE &kp KEY_UNDERSCORE,                                        &hmr LCTRL KEY_EQUAL &hmr RSHFT KEY_RIGHT_BRACE &hmr LALT KEY_RIGHT_BRACKET &hmr LGUI KEY_RIGHT_PAREN &kp KEY_GT        XXX              ,
//├─────────────────┼─────────────────┼─────────────────┼─────────────────┼─────────────────┼─────────────────┤─────────────────╮   ╭─────────────────├─────────────────┼─────────────────┼─────────────────┼─────────────────┼─────────────────┼─────────────────┤
   XXX               &kp KEY_BACKTICK  &kp KEY_TILDE     &kp KEY_DOT       &kp KEY_BACKSLASH &kp KEY_QUOTE    ,___              ,    ___              ,&kp KEY_SQUOTE    &kp KEY_COLON     &kp KEY_SEMICOLON &kp KEY_QUESTION  &kp KEY_EXCLAMATION XXX              ,
//╰─────────────────┴─────────────────┼─────────────────┼─────────────────┼─────────────────┼─────────────────┼─────────────────┤   ├─────────────────┼─────────────────┼─────────────────┼─────────────────┼─────────────────┼─────────────────┴─────────────────╯
                                       ___               ___               ___               ___               ___              ,    ___               ___               ___               ___               ___
//                                    ╰─────────────────┴─────────────────┴─────────────────┴─────────────────┴─────────────────╯   ╰─────────────────┴─────────────────┴─────────────────┴─────────────────┴─────────────────╯
)

ZMK_BASE_LAYER(Num,
//╭─────────────────┬─────────────────┬─────────────────┬─────────────────┬─────────────────┬─────────────────╮                                       ╭─────────────────┬─────────────────┬─────────────────┬─────────────────┬─────────────────┬─────────────────╮
   ___                ___                ___                ___                ___                ___               ,                                  ___               ___               ___               ___               ___               ___              ,
//├─────────────────┼─────────────────┼─────────────────┼─────────────────┼─────────────────┼─────────────────┤                                       ├─────────────────┼─────────────────┼─────────────────┼─────────────────┼─────────────────┼─────────────────┤
   XXX                XXX                &kp KEY_SLASH      XXX             &kp KEY_COMMA         XXX               ,                                  XXX               &kp N7            &kp N8            &kp N9            XXX               XXX              ,
//├─────────────────┼─────────────────┼─────────────────┼─────────────────┼─────────────────┼─────────────────┤                                       ├─────────────────┼─────────────────┼─────────────────┼─────────────────┼─────────────────┼─────────────────┤
   XXX                &hml LGUI KEY_PLUS &hml LALT KEY_MINUS &hml LSHFT KEY_STAR &hml LCTRL KEY_EQUAL XXX           ,                                  &kp KEY_DOT       &kp N4            &kp N5            &kp N6            XXX               XXX              ,
//├─────────────────┼─────────────────┼─────────────────┼─────────────────┼─────────────────┼─────────────────┤─────────────────╮   ╭─────────────────├─────────────────┼─────────────────┼─────────────────┼─────────────────┼─────────────────┼─────────────────┤
   XXX                XXX                XXX                XXX                XXX                XXX               ,___            ,___              ,&kp N0            &kp N1            &kp N2            &kp N3            XXX               XXX              ,
//╰─────────────────┴─────────────────┼─────────────────┼─────────────────┼─────────────────┼─────────────────┼─────────────────┤   ├─────────────────┼─────────────────┼─────────────────┼─────────────────┼─────────────────┼─────────────────┴─────────────────╯
                                          ___                ___                ___               ___               ___                ,___              ___              ___               ___               ___
//                                    ╰─────────────────┴─────────────────┴─────────────────┴─────────────────┴─────────────────╯   ╰─────────────────┴─────────────────┴─────────────────┴─────────────────┴─────────────────╯
)

ZMK_BASE_LAYER(FN,
//╭─────────────────┬─────────────────┬─────────────────┬─────────────────┬─────────────────┬─────────────────╮                                       ╭─────────────────┬─────────────────┬─────────────────┬─────────────────┬─────────────────┬─────────────────╮
   ___               ___               ___               ___               ___               ___              ,                                        ___               &kp F10           &kp F11           &kp F12           ___               ___              ,
//├─────────────────┼─────────────────┼─────────────────┼─────────────────┼─────────────────┼─────────────────┤                                       ├─────────────────┼─────────────────┼─────────────────┼─────────────────┼─────────────────┼─────────────────┤
   XXX               &bt BT_SEL 0      &bt BT_SEL 1      &bt BT_SEL 2      &bt BT_SEL 3      &bt BT_CLR       ,                                        ___               &kp F7            &kp F8            &kp F9            ___               ___              ,
//├─────────────────┼─────────────────┼─────────────────┼─────────────────┼─────────────────┼─────────────────┤                                       ├─────────────────┼─────────────────┼─────────────────┼─────────────────┼─────────────────┼─────────────────┤
   ___               ___               ___               ___               ___               ___              ,                                        ___               &kp F4            &kp F5            &kp F6            ___               ___              ,
//├─────────────────┼─────────────────┼─────────────────┼─────────────────┼─────────────────┼─────────────────┤─────────────────╮   ╭─────────────────├─────────────────┼─────────────────┼─────────────────┼─────────────────┼─────────────────┼─────────────────┤
   XXX               &kp C_PP          &kp C_PREV        &kp C_NEXT        &kp C_VOL_DN      &kp C_VOL_UP     ,___            ,___              ,___               &kp F1            &kp F2            &kp F3            ___               ___              ,
//╰─────────────────┴─────────────────┼─────────────────┼─────────────────┼─────────────────┼─────────────────┼─────────────────┤   ├─────────────────┼─────────────────┼─────────────────┼─────────────────┼─────────────────┼─────────────────┴─────────────────╯
                                         ___               ___               ___               ___               ___              ,    ___               ___               ___               ___               ___
//                                    ╰─────────────────┴─────────────────┴─────────────────┴─────────────────┴─────────────────╯   ╰─────────────────┴─────────────────┴─────────────────┴─────────────────┴─────────────────╯
)

ZMK_BASE_LAYER(MOUSE,
//╭─────────────────┬─────────────────┬─────────────────┬─────────────────┬─────────────────┬─────────────────╮                                       ╭─────────────────┬─────────────────┬─────────────────┬─────────────────┬─────────────────┬─────────────────╮
   ___               ___               ___               ___               ___               ___              ,                                        ___               ___               ___               ___               ___               ___              ,
//├─────────────────┼─────────────────┼─────────────────┼─────────────────┼─────────────────┼─────────────────┤                                       ├─────────────────┼─────────────────┼─────────────────┼─────────────────┼─────────────────┼─────────────────┤
   ___               ___               ___               ___               ___               ___              ,                                        ___               ___               ___               ___               ___               ___              ,
//├─────────────────┼─────────────────┼─────────────────┼─────────────────┼─────────────────┼─────────────────┤                                       ├─────────────────┼─────────────────┼─────────────────┼─────────────────┼─────────────────┼─────────────────┤
   ___               ___               ___               ___               ___               ___              ,                                        ___               ___               ___               ___               ___               ___              ,
//├─────────────────┼─────────────────┼─────────────────┼─────────────────┼─────────────────┼─────────────────┤─────────────────╮   ╭─────────────────├─────────────────┼─────────────────┼─────────────────┼─────────────────┼─────────────────┼─────────────────┤
   ___               ___               ___               ___               ___               ___              ,___              ,    ___              ,___               ___               ___               ___               ___               ___              ,
//╰─────────────────┴─────────────────┼─────────────────┼─────────────────┼─────────────────┼─────────────────┼─────────────────┤   ├─────────────────┼─────────────────┼─────────────────┼─────────────────┼─────────────────┼─────────────────┴─────────────────╯
                                       ___               ___               ___               ___               ___              ,    ___               ___               ___               ___               ___
//                                    ╰─────────────────┴─────────────────┴─────────────────┴─────────────────┴─────────────────╯   ╰─────────────────┴─────────────────┴─────────────────┴─────────────────┴─────────────────╯
)
